#pragma once
// =============================================================================
//  ReflectState.h - generic, heap-free typed state store (C++17)
//                   Part of the Reflect family (ReflectJSON, ReflectINI)
//
//  Copyright (c) 2026 Michael
//  Free for noncommercial use (PolyForm Noncommercial 1.0.0).
//  Commercial licensing available under separate written agreement.
//  See LICENSE and COMMERCIAL.md.
//  https://github.com/Michael-0-sys/ReflectState
//
//  Structs use the same reflection metadata as ReflectJSON and ReflectINI
//  (ReflectCore.h): one description for JSON, INI and state change detection.
//
//      struct MotorData {
//          float power;
//          float current;
//          int   rpm;
//          REFLECT(
//              MEMBER(power, fn(power, 1)),   // fn()/fx() only affect JSON/INI formatting
//              MEMBER(current),              // ReflectState compares the raw float value
//              MEMBER_AS("rpm", rpm)         // custom key names do not affect comparison
//          )
//      };
//
//  State variables and their types are declared once with STATE_VARIABLES.
//  After that, no API call needs an explicit <Type>:
//
//      STATE_VARIABLES(Variable,
//          STATE_VAR(Speed, float),
//          STATE_VAR(Power, uint32_t),
//          STATE_VAR(Motor, MotorData)
//      )
//
//      StateManager<Variable, 256, 8, reflectstate::PicoLock> state;
//
//      state.addAll();                              // register all with initial value T{}
//      state.set(Variable::Power, 750);             // 750 is converted to uint32_t
//      MotorData m = state.get(Variable::Motor);
//      state.onChange(Variable::Speed, [](const float& oldV, const float& newV) { ... });
//
//  A mismatched type, for example an int callback for Speed, is a compile error.
//  Types without REFLECT() are compared with operator==, or with a custom
//  comparator installed through setComparator().
//
//  Target platforms: RP2040/RP2350 (Pico/Pico 2), ESP32/ESP32-S3, Teensy 3.x/4.x,
//  Arduino UNO R4 and PC hosts (unit tests).
//
//  Features:
//  - no heap allocation inside StateManager, no std::map and no std::function
//  - fixed and predictable RAM usage; all storage is part of the object
//  - every state variable may use a different copyable C++ type
//    (add(Var)/get() require a default constructor unless an initial/fallback
//    value is supplied through add(..., initial), tryGet() or getOr())
//  - change detection for REFLECT() structs, std::optional, arrays and operator==
//    (char arrays are compared as strings, matching ReflectJSON/ReflectINI)
//  - multiple listeners per state variable: functions, captureless lambdas,
//    context callbacks and member functions
//  - callbacks may add/remove listeners, remove state variables and call set();
//    nested dispatch depth is limited by STATE_MAX_DISPATCH_DEPTH
//  - optional thread/core/interrupt safety through a lock policy
//  - trySet()/tryUpdate() provide detailed results; setComparator() supports
//    custom comparison rules such as float tolerances inside structs
//  - clear() resets all stored values, listeners, comparators and tolerances
//
//  Template parameters:
//    StateManager<Variable, StorageBytes = 256, MaxListeners = 16,
//                 LockPolicy = reflectstate::NoLock>
//
//      Variable     : descriptor generated by STATE_VARIABLES
//      StorageBytes : shared byte pool for all stored values
//      MaxListeners : maximum listener count across all variables; 0 is allowed
//      LockPolicy   : class providing lock()/unlock(), see "Locking" below
//
//  Errors:
//    Failed calls return false (or a default value for get()) and set
//    lastErrorCode() plus lastError(). The error is sticky: it remains available
//    until clearError() is called or a later error replaces it.
//
//    To report errors when they occur, define this before including ReflectState.h:
//
//        #define STATE_ON_ERROR(msg) Serial.println(msg)
//
//    STATE_ON_ERROR is never called while the manager's lock is held. It runs
//    immediately after the failed operation releases the lock. Inside an explicit
//    scopedLock() block, reporting is deferred until the outer lock is released.
//    If an error occurs in an interrupt, STATE_ON_ERROR runs in that interrupt.
//
//  Locking:
//    reflectstate::NoLock is the default and has no synchronization overhead.
//    Use a lock policy when multiple cores, RTOS tasks or interrupts access the
//    same StateManager.
//
//      reflectstate::NoLock    - single execution context, no ISR access
//      reflectstate::IrqLock   - one Cortex-M core; briefly disables interrupts
//      reflectstate::PicoLock  - RP2040/RP2350 spinlock + local IRQ protection
//      reflectstate::Esp32Lock - ESP32 portMUX, safe for tasks, cores and ISRs
//
//    Custom policies only need void lock() and void unlock(). They must be
//    recursive only when StateManager::lock()/scopedLock() are used explicitly.
//
//    Callbacks normally run without the manager lock held to avoid deadlocks and
//    long critical sections. They receive copies of old/new values. Concurrent
//    set() calls from different cores can therefore be observed in a different
//    callback order than the final storage order.
//
//    Multiple operations can be grouped atomically:
//      { auto g = state.scopedLock(); ... }
//
//    Callbacks triggered inside such an explicit block run while the outer lock
//    remains held, so the chosen lock policy must support recursion.
// =============================================================================

#include <array>
#include <cmath>
#include <cstddef>
#include <cstdint>
#include <cstring>
#include <iterator>
#include <new>
#include <tuple>
#include <type_traits>
#include <utility>

// Shared reflection core used by ReflectJSON, ReflectINI and ReflectState.
// Each library ships an identical copy. ReflectCore.h detects incompatible
// versions when different copies are included in the same build.
#include "ReflectCore.h"
#if !defined(REFLECTCORE_VERSION) || (REFLECTCORE_VERSION != 6)
#error "ReflectState.h requires ReflectCore.h version 6"
#endif

#ifndef STATE_ON_ERROR
#define STATE_ON_ERROR(msg) ((void)0)
#endif

// Maximum nested callback dispatch depth (for example set() from a callback).
// Prevents accidental infinite recursion and a resulting stack overflow.
// Counts all dispatches active at the same time, including another core.
#ifndef STATE_MAX_DISPATCH_DEPTH
#define STATE_MAX_DISPATCH_DEPTH 16
#endif

#if defined(ARDUINO_ARCH_RP2040) || defined(PICO_SDK_VERSION_MAJOR)
#include "hardware/sync.h"
#include "pico.h"
#define STATE_HAS_PICO_LOCK 1
#endif

#if defined(ESP_PLATFORM)
#include "freertos/FreeRTOS.h"
#define STATE_HAS_ESP32_LOCK 1
#endif

namespace reflectstate {

// -----------------------------------------------------------------------------
//  Error codes
// -----------------------------------------------------------------------------
enum class Error : std::uint8_t {
    None,
    KeyNotFound,        // state variable is not registered
    AlreadyRegistered,  // add() called for an already registered key
    StorageFull,        // StorageBytes is insufficient
    ListenerFull,       // MaxListeners limit reached
    NullCallback,       // callback is nullptr
    MaxDepth,           // STATE_MAX_DISPATCH_DEPTH reached (recursive dispatch?)
    InDispatch,         // clear() while callbacks are running, including on another core
    NotComparable,      // type has no REFLECT()/operator== and no setComparator()
    NotDefaultConstructible  // addAll(): no default constructor and not registered beforehand
};

inline const char* errorText(Error e) {
    switch (e) {
        case Error::None: return "no error";
        case Error::KeyNotFound: return "state variable not registered";
        case Error::AlreadyRegistered: return "key already registered";
        case Error::StorageFull: return "StorageBytes too small";
        case Error::ListenerFull: return "MaxListeners reached";
        case Error::NullCallback: return "callback is null";
        case Error::MaxDepth: return "maximum callback depth reached";
        case Error::InDispatch: return "not allowed while callbacks are running";
        case Error::NotComparable: return "type is not comparable (REFLECT, operator== or setComparator)";
        case Error::NotDefaultConstructible: return "type has no default constructor: register it first with add(Variable, initialValue)";
    }
    return "?";
}

// -----------------------------------------------------------------------------
//  Result of trySet() / tryUpdate()
// -----------------------------------------------------------------------------
enum class SetStatus : std::uint8_t {
    Error,         // nothing changed; reason is in SetResult::error
    Unchanged,     // equal according to the active comparison -> nothing stored
    StoredSilent,  // float/double within tolerance: stored without notification
    Changed        // changed and stored; active listeners were dispatched
                   // (even when no listeners are registered)
};

inline const char* statusText(SetStatus s) {
    switch (s) {
        case SetStatus::Error: return "error";
        case SetStatus::Unchanged: return "unchanged";
        case SetStatus::StoredSilent: return "stored silently";
        case SetStatus::Changed: return "changed";
    }
    return "?";
}

// This error code belongs to exactly this call, unlike lastErrorCode(), which
// may already have been overwritten by another core or ISR.
struct SetResult {
    SetStatus status;
    Error error;  // Error::None unless status == SetStatus::Error

    bool ok() const { return status != SetStatus::Error; }
    bool changed() const { return status == SetStatus::Changed; }  // same condition returned by set()
    bool stored() const { return status == SetStatus::StoredSilent || status == SetStatus::Changed; }
};

// -----------------------------------------------------------------------------
//  Lock policies
// -----------------------------------------------------------------------------
struct NoLock {
    void lock() {}
    void unlock() {}
};

#if defined(__arm__) && (defined(__ARM_ARCH_6M__) || defined(__ARM_ARCH_7M__) ||    \
                         defined(__ARM_ARCH_7EM__) || defined(__ARM_ARCH_8M_BASE__) || \
                         defined(__ARM_ARCH_8M_MAIN__) || defined(__ARM_ARCH_8_1M_MAIN__))
// Recursive PRIMASK lock. Restores the previous interrupt state.
// Protects against interrupts on the same core only, not against another core.
class IrqLock {
public:
    void lock() {
        std::uint32_t primask;
        __asm volatile("mrs %0, primask" : "=r"(primask));
        __asm volatile("cpsid i" ::: "memory");
        if (depth_++ == 0) saved_ = primask;
    }
    void unlock() {
        if (--depth_ == 0 && !(saved_ & 1u)) __asm volatile("cpsie i" ::: "memory");
    }

private:
    std::uint32_t saved_ = 0;
    std::uint8_t depth_ = 0;
};
#define STATE_HAS_IRQ_LOCK 1
#endif

#ifdef STATE_HAS_PICO_LOCK
// Hardware spinlock with local interrupts disabled; recursive per core.
// Uses one of the SDK striped spinlocks, so no separate claim/init is required
// and the lock is safe to construct as a global object before setup().
//
// Each core owns its own recursion depth and saved IRQ state. A core accesses
// only its own fields; cross-core synchronization is provided exclusively by
// the hardware spinlock. While depth_ > 0, interrupts are disabled on that core,
// so an ISR cannot modify that core's recursion state.
class PicoLock {
public:
    PicoLock() : sl_(spin_lock_instance(next_striped_spin_lock_num())) {}
    void lock() {
        const unsigned core = get_core_num();
        if (depth_[core] != 0) {  // this core already holds the lock
            ++depth_[core];
            return;
        }
        saved_[core] = spin_lock_blocking(sl_);
        depth_[core] = 1;
    }
    void unlock() {
        const unsigned core = get_core_num();
        if (--depth_[core] == 0) spin_unlock(sl_, saved_[core]);
    }

private:
    static constexpr unsigned kCores = NUM_CORES;
    spin_lock_t* sl_;
    std::uint32_t saved_[kCores] = {};
    std::uint8_t depth_[kCores] = {};
};
#endif

#ifdef STATE_HAS_ESP32_LOCK
// ESP-IDF portMUX critical section. Excludes the other core and masks local
// interrupts up to the FreeRTOS critical-section level.
// Critical sections are recursive per core under ESP-IDF.
// The _SAFE variants select task or ISR handling automatically, so the same
// instance can be used from loop(), other tasks and normal ISRs.
// For ESP_INTR_FLAG_IRAM ISRs, all called code and involved types must also be
// IRAM-safe; when in doubt, set a flag in the ISR and access state from a task.
class Esp32Lock {
public:
    Esp32Lock() { portMUX_INITIALIZE(&mux_); }
    void lock() { portENTER_CRITICAL_SAFE(&mux_); }
    void unlock() { portEXIT_CRITICAL_SAFE(&mux_); }

private:
    portMUX_TYPE mux_;
};
#endif


// -----------------------------------------------------------------------------
//  Comparison (reflection comes from ReflectCore: REFLECT / MEMBER / MEMBER_AS)
// -----------------------------------------------------------------------------
namespace detail {

template <class T>
struct IsStdArray : std::false_type {};
template <class T, std::size_t N>
struct IsStdArray<std::array<T, N>> : std::true_type {};

template <class T, class = void>
struct HasEqualOp : std::false_type {};
template <class T>
struct HasEqualOp<T, std::void_t<decltype(std::declval<const T&>() == std::declval<const T&>())>>
    : std::true_type {};

template <class>
inline constexpr bool dependentFalse = false;

// Is T a REFLECT() struct from ReflectCore (member function reflect(visitor))?
template <class T>
inline constexpr bool IsCoreReflect = ::is_reflectable_v<T>;

// Unwrap FieldRef::value. fn()/fx() return JsonNumber/JsonFixed wrappers around
// the real value; their precision affects JSON/INI representation only and is
// intentionally ignored by state comparison.
template <class V>
constexpr decltype(auto) unwrapField(V& v) {
    using U = std::remove_cv_t<V>;
    if constexpr (::is_json_number_v<U> || ::is_json_fixed_v<U>)
        return (v.value);
    else
        return (v);
}

// COMMENT("...") inside REFLECT() produces ReflectComment instead of FieldRef.
// Comments are documentation for INIwriter only and are skipped by comparison
// and forEachMember().
template <class F>
inline constexpr bool IsComment = ::is_reflect_comment_v<F>;

template <class T>
inline constexpr bool IsCharArray =
    std::is_array<T>::value && std::is_same<std::remove_cv_t<std::remove_extent_t<T>>, char>::value;

// Recursive comparison for REFLECT() structs, std::optional, char arrays,
// regular arrays and types with operator==.
// tol > 0: float/double members, including nested members, compare equal when
// |a - b| <= tol; two NaN values compare equal. tol == 0 uses exact equality.
//
// Two modes:
//   Strict = true  (equal(), approxEqual()):
//                  a non-comparable type is a compile-time error.
//   Strict = false (default comparison used by set()):
//                  a non-comparable type sets ok = false instead. This allows a
//                  REFLECT() struct containing a foreign type without operator==
//                  to compile so setComparator() can provide the comparison.
//                  Reflectability of every nested field cannot be determined
//                  from reflect() at compile time because reflect() returns void.
//                  Therefore every field is visited in tolerant mode and an empty
//                  optional probes its value type when default construction allows it.
template <bool Strict, class FA, class FB>
bool fieldEqual(const FA& fa, const FB& fb, double tol, bool& ok);

// Pairwise comparison of two reflection packs: fa comes as a tuple of references,
// fb as a pack. Helper functions instead of nested lambdas: GCC 7 (Renesas core,
// Arduino UNO R4) cannot capture the parameter pack of an outer generic lambda
// in an inner lambda.
template <bool Strict, class TupA, std::size_t... I, class... FB>
bool reflectPackEqual(const TupA& ta, std::index_sequence<I...>, double tol, bool& ok, const FB&... fb) {
    if constexpr (Strict) {
        return (true && ... && fieldEqual<Strict>(std::get<I>(ta), fb, tol, ok));
    } else {
        // Comma fold: every field is visited, the comparison comes first
        bool same = true;
        ((same = fieldEqual<Strict>(std::get<I>(ta), fb, tol, ok) && same), ...);
        (void)tol;
        (void)ok;
        return same;
    }
}

template <bool Strict, class T, class TupA>
bool reflectEqualWith(const T& b, const TupA& ta, double tol, bool& ok) {
    bool same = true;
    b.reflect([&](const auto&... fb) {
        same = reflectPackEqual<Strict>(ta, std::index_sequence_for<decltype(fb)...>{}, tol, ok, fb...);
    });
    return same;
}

template <bool Strict, class T>
bool equalImpl(const T& a, const T& b, double tol, bool& ok) {
    if constexpr (std::is_floating_point<T>::value) {
        if (tol <= 0.0) return a == b;
        const bool na = std::isnan(a), nb = std::isnan(b);
        if (na || nb) return na && nb;
        return std::fabs(static_cast<double>(a) - static_cast<double>(b)) <= tol;
    } else if constexpr (::is_json_optional_v<T>) {
        // std::optional: both empty means equal; otherwise compare the contained
        // value recursively, so optional<Struct> does not need operator==.
        using V = typename T::value_type;
        if (a.has_value() && b.has_value()) return equalImpl<Strict>(*a, *b, tol, ok);
        if constexpr (!Strict && std::is_default_constructible<V>::value) {
            const V probe{};
            (void)equalImpl<Strict>(probe, probe, tol, ok);  // type check only
        }
        return a.has_value() == b.has_value();
    } else if constexpr (IsCharArray<T>) {
        // char[N] is treated as a string, matching ReflectJSON/ReflectINI.
        // Bytes after the first '\0' do not count as a change.
        return std::strncmp(a, b, std::extent<T>::value) == 0;
    } else if constexpr (IsCoreReflect<T>) {
        // Both objects expose the same reflection entries in the same order.
        // The entries of a are bundled as a tuple of references (valid while a.reflect() runs).
        bool same = true;
        a.reflect([&](const auto&... fa) {
            same = reflectEqualWith<Strict>(b, std::forward_as_tuple(fa...), tol, ok);
        });
        return same;
    } else if constexpr (IsStdArray<T>::value || std::is_array<T>::value) {
        // Early exit on the first different array element is safe even in tolerant
        // mode: element 0 is always fully inspected and all elements share a type.
        for (std::size_t i = 0; i < std::size(a); ++i)
            if (!equalImpl<Strict>(a[i], b[i], tol, ok)) return false;
        return true;
    } else if constexpr (HasEqualOp<T>::value) {
        return static_cast<bool>(a == b);
    } else {
        static_assert(!Strict || dependentFalse<T>,
                      "ReflectState: type is not comparable. Add REFLECT(...) to the struct or "
                      "define operator== (or use setComparator()).");
        ok = false;
        return false;
    }
}

// A pair of reflection entries comes from the same struct type and position.
// Therefore a comment always corresponds to a comment.
template <bool Strict, class FA, class FB>
bool fieldEqual(const FA& fa, const FB& fb, double tol, bool& ok) {
    if constexpr (IsComment<FA>)
        return true;
    else
        return equalImpl<Strict>(unwrapField(fa.value), unwrapField(fb.value), tol, ok);
}

template <class T>
bool equal(const T& a, const T& b, double tol = 0.0) {
    bool ok = true;
    return equalImpl<true>(a, b, tol, ok);
}

// Decompose member callback: void C::f(const T&, const T&) [const].
template <class F>
struct MemberCallback {
    static constexpr bool valid = false;
};
template <class C, class T>
struct MemberCallback<void (C::*)(const T&, const T&)> {
    static constexpr bool valid = true;
    using Object = C;
    using Value = T;
};
template <class C, class T>
struct MemberCallback<void (C::*)(const T&, const T&) const> {
    static constexpr bool valid = true;
    using Object = const C;
    using Value = T;
};

// RTTI-free type ID: address of one unique static object per type.
using TypeId = const void*;
template <class T>
struct TypeTag {
    static constexpr char id = 0;
};
template <class T>
constexpr TypeId typeId() {
    return &TypeTag<T>::id;
}

}  // namespace detail

// true for REFLECT() structs
template <class T>
inline constexpr bool isReflected = detail::IsCoreReflect<std::remove_cv_t<T>>;

// Same comparison rules as the default, but with tolerance for float/double
// members. Useful inside custom comparators, for example:
//   bool motorEqual(const MotorData& a, const MotorData& b) {
//       return reflectstate::approxEqual(a, b, 0.05);
//   }
template <class T>
bool approxEqual(const T& a, const T& b, double tolerance) {
    return detail::equal(a, b, std::fabs(tolerance));
}

namespace detail {
template <class F, class FR>
void visitMember(F& f, FR& fr) {
    if constexpr (!IsComment<FR>) f(fr.key, unwrapField(fr.value));
}
}  // namespace detail

// Iterate over all reflected members: f(const char* name, member&).
// COMMENT("...") entries are skipped. name is the MEMBER/MEMBER_AS key;
// fn()/fx() wrappers are unwrapped so f receives the actual value.
template <class T, class F>
void forEachMember(T& obj, F&& f) {
    using U = std::remove_cv_t<T>;
    static_assert(isReflected<U>, "forEachMember: type has no REFLECT()");
    obj.reflect([&](auto&&... fr) { (detail::visitMember(f, fr), ...); });
}

// -----------------------------------------------------------------------------
//  Typed state variables (STATE_VARIABLES)
// -----------------------------------------------------------------------------
// Every state variable is an empty type carrying both key and value type. This
// lets the compiler infer the return type of state.get(Variable::Speed), which a
// plain enum cannot provide. The underlying enum key is available as
// Variable::Speed.key when needed, for example in a switch.
template <auto K, class T>
struct Var {
    static_assert(std::is_enum<decltype(K)>::value, "Var<K, T>: K must be an enum value");
    using Type = T;
    using Key = decltype(K);
    static constexpr Key key = K;
};

namespace detail {
// Is T a descriptor struct generated by STATE_VARIABLES?
template <class T, class = void>
struct IsVariables : std::false_type {};
template <class T>
struct IsVariables<T, std::void_t<typename T::Id, decltype(T::Id::Count)>>
    : std::is_enum<typename T::Id> {};

// Prevent template argument deduction from this parameter (C++20: std::type_identity_t).
template <class T>
struct TypeIdentity {
    using type = T;
};
template <class T>
using NoDeduce = typename TypeIdentity<T>::type;
}  // namespace detail

}  // namespace reflectstate

// -----------------------------------------------------------------------------
//  STATE_VARIABLES - declare keys and value types in one place
//
//      STATE_VARIABLES(Variable,
//          STATE_VAR(Sequence, uint32_t),
//          STATE_VAR(Speed,    float),
//          STATE_VAR(Motor,    MotorData),
//          STATE_VAR(Temps,    std::array<float, 8>)   // commas in the type are supported
//      )
//
//  Generates at namespace scope:
//
//      enum class Variable_Id : uint16_t { Sequence, Speed, Motor, Temps, Count };
//      struct Variable {
//          using Id = Variable_Id;
//          static constexpr reflectstate::Var<Id::Sequence, uint32_t> Sequence{};
//          ...
//      };
//
//      Variable::forEach([](auto var, const char* name) { ... });
//
//  Usage without explicit <Type>:
//
//      StateManager<Variable, 256, 8> state;
//      state.add(Variable::Speed);                  // initial value float{}
//      state.add(Variable::Sequence, 5);            // converted to uint32_t
//      state.addAll();                              // register all remaining values with T{}
//      float s = state.get(Variable::Speed);        // return type inferred
//      state.set(Variable::Speed, 1.5f);
//      state.onChange(Variable::Speed, [](const float& oldV, const float& newV) { ... });
//
//  A mismatched type is a compile-time error. Up to 64 entries are supported by
//  one STATE_VARIABLES declaration. Id, Count, forEach and TypeOf are reserved.
// -----------------------------------------------------------------------------
#define STATE_PP_EXPAND(x) x
#define STATE_PP_FE_1(m, x) m(x)
#define STATE_PP_FE_2(m, x, ...) m(x) STATE_PP_EXPAND(STATE_PP_FE_1(m, __VA_ARGS__))
#define STATE_PP_FE_3(m, x, ...) m(x) STATE_PP_EXPAND(STATE_PP_FE_2(m, __VA_ARGS__))
#define STATE_PP_FE_4(m, x, ...) m(x) STATE_PP_EXPAND(STATE_PP_FE_3(m, __VA_ARGS__))
#define STATE_PP_FE_5(m, x, ...) m(x) STATE_PP_EXPAND(STATE_PP_FE_4(m, __VA_ARGS__))
#define STATE_PP_FE_6(m, x, ...) m(x) STATE_PP_EXPAND(STATE_PP_FE_5(m, __VA_ARGS__))
#define STATE_PP_FE_7(m, x, ...) m(x) STATE_PP_EXPAND(STATE_PP_FE_6(m, __VA_ARGS__))
#define STATE_PP_FE_8(m, x, ...) m(x) STATE_PP_EXPAND(STATE_PP_FE_7(m, __VA_ARGS__))
#define STATE_PP_FE_9(m, x, ...) m(x) STATE_PP_EXPAND(STATE_PP_FE_8(m, __VA_ARGS__))
#define STATE_PP_FE_10(m, x, ...) m(x) STATE_PP_EXPAND(STATE_PP_FE_9(m, __VA_ARGS__))
#define STATE_PP_FE_11(m, x, ...) m(x) STATE_PP_EXPAND(STATE_PP_FE_10(m, __VA_ARGS__))
#define STATE_PP_FE_12(m, x, ...) m(x) STATE_PP_EXPAND(STATE_PP_FE_11(m, __VA_ARGS__))
#define STATE_PP_FE_13(m, x, ...) m(x) STATE_PP_EXPAND(STATE_PP_FE_12(m, __VA_ARGS__))
#define STATE_PP_FE_14(m, x, ...) m(x) STATE_PP_EXPAND(STATE_PP_FE_13(m, __VA_ARGS__))
#define STATE_PP_FE_15(m, x, ...) m(x) STATE_PP_EXPAND(STATE_PP_FE_14(m, __VA_ARGS__))
#define STATE_PP_FE_16(m, x, ...) m(x) STATE_PP_EXPAND(STATE_PP_FE_15(m, __VA_ARGS__))
#define STATE_PP_FE_17(m, x, ...) m(x) STATE_PP_EXPAND(STATE_PP_FE_16(m, __VA_ARGS__))
#define STATE_PP_FE_18(m, x, ...) m(x) STATE_PP_EXPAND(STATE_PP_FE_17(m, __VA_ARGS__))
#define STATE_PP_FE_19(m, x, ...) m(x) STATE_PP_EXPAND(STATE_PP_FE_18(m, __VA_ARGS__))
#define STATE_PP_FE_20(m, x, ...) m(x) STATE_PP_EXPAND(STATE_PP_FE_19(m, __VA_ARGS__))
#define STATE_PP_FE_21(m, x, ...) m(x) STATE_PP_EXPAND(STATE_PP_FE_20(m, __VA_ARGS__))
#define STATE_PP_FE_22(m, x, ...) m(x) STATE_PP_EXPAND(STATE_PP_FE_21(m, __VA_ARGS__))
#define STATE_PP_FE_23(m, x, ...) m(x) STATE_PP_EXPAND(STATE_PP_FE_22(m, __VA_ARGS__))
#define STATE_PP_FE_24(m, x, ...) m(x) STATE_PP_EXPAND(STATE_PP_FE_23(m, __VA_ARGS__))
#define STATE_PP_FE_25(m, x, ...) m(x) STATE_PP_EXPAND(STATE_PP_FE_24(m, __VA_ARGS__))
#define STATE_PP_FE_26(m, x, ...) m(x) STATE_PP_EXPAND(STATE_PP_FE_25(m, __VA_ARGS__))
#define STATE_PP_FE_27(m, x, ...) m(x) STATE_PP_EXPAND(STATE_PP_FE_26(m, __VA_ARGS__))
#define STATE_PP_FE_28(m, x, ...) m(x) STATE_PP_EXPAND(STATE_PP_FE_27(m, __VA_ARGS__))
#define STATE_PP_FE_29(m, x, ...) m(x) STATE_PP_EXPAND(STATE_PP_FE_28(m, __VA_ARGS__))
#define STATE_PP_FE_30(m, x, ...) m(x) STATE_PP_EXPAND(STATE_PP_FE_29(m, __VA_ARGS__))
#define STATE_PP_FE_31(m, x, ...) m(x) STATE_PP_EXPAND(STATE_PP_FE_30(m, __VA_ARGS__))
#define STATE_PP_FE_32(m, x, ...) m(x) STATE_PP_EXPAND(STATE_PP_FE_31(m, __VA_ARGS__))
#define STATE_PP_FE_33(m, x, ...) m(x) STATE_PP_EXPAND(STATE_PP_FE_32(m, __VA_ARGS__))
#define STATE_PP_FE_34(m, x, ...) m(x) STATE_PP_EXPAND(STATE_PP_FE_33(m, __VA_ARGS__))
#define STATE_PP_FE_35(m, x, ...) m(x) STATE_PP_EXPAND(STATE_PP_FE_34(m, __VA_ARGS__))
#define STATE_PP_FE_36(m, x, ...) m(x) STATE_PP_EXPAND(STATE_PP_FE_35(m, __VA_ARGS__))
#define STATE_PP_FE_37(m, x, ...) m(x) STATE_PP_EXPAND(STATE_PP_FE_36(m, __VA_ARGS__))
#define STATE_PP_FE_38(m, x, ...) m(x) STATE_PP_EXPAND(STATE_PP_FE_37(m, __VA_ARGS__))
#define STATE_PP_FE_39(m, x, ...) m(x) STATE_PP_EXPAND(STATE_PP_FE_38(m, __VA_ARGS__))
#define STATE_PP_FE_40(m, x, ...) m(x) STATE_PP_EXPAND(STATE_PP_FE_39(m, __VA_ARGS__))
#define STATE_PP_FE_41(m, x, ...) m(x) STATE_PP_EXPAND(STATE_PP_FE_40(m, __VA_ARGS__))
#define STATE_PP_FE_42(m, x, ...) m(x) STATE_PP_EXPAND(STATE_PP_FE_41(m, __VA_ARGS__))
#define STATE_PP_FE_43(m, x, ...) m(x) STATE_PP_EXPAND(STATE_PP_FE_42(m, __VA_ARGS__))
#define STATE_PP_FE_44(m, x, ...) m(x) STATE_PP_EXPAND(STATE_PP_FE_43(m, __VA_ARGS__))
#define STATE_PP_FE_45(m, x, ...) m(x) STATE_PP_EXPAND(STATE_PP_FE_44(m, __VA_ARGS__))
#define STATE_PP_FE_46(m, x, ...) m(x) STATE_PP_EXPAND(STATE_PP_FE_45(m, __VA_ARGS__))
#define STATE_PP_FE_47(m, x, ...) m(x) STATE_PP_EXPAND(STATE_PP_FE_46(m, __VA_ARGS__))
#define STATE_PP_FE_48(m, x, ...) m(x) STATE_PP_EXPAND(STATE_PP_FE_47(m, __VA_ARGS__))
#define STATE_PP_FE_49(m, x, ...) m(x) STATE_PP_EXPAND(STATE_PP_FE_48(m, __VA_ARGS__))
#define STATE_PP_FE_50(m, x, ...) m(x) STATE_PP_EXPAND(STATE_PP_FE_49(m, __VA_ARGS__))
#define STATE_PP_FE_51(m, x, ...) m(x) STATE_PP_EXPAND(STATE_PP_FE_50(m, __VA_ARGS__))
#define STATE_PP_FE_52(m, x, ...) m(x) STATE_PP_EXPAND(STATE_PP_FE_51(m, __VA_ARGS__))
#define STATE_PP_FE_53(m, x, ...) m(x) STATE_PP_EXPAND(STATE_PP_FE_52(m, __VA_ARGS__))
#define STATE_PP_FE_54(m, x, ...) m(x) STATE_PP_EXPAND(STATE_PP_FE_53(m, __VA_ARGS__))
#define STATE_PP_FE_55(m, x, ...) m(x) STATE_PP_EXPAND(STATE_PP_FE_54(m, __VA_ARGS__))
#define STATE_PP_FE_56(m, x, ...) m(x) STATE_PP_EXPAND(STATE_PP_FE_55(m, __VA_ARGS__))
#define STATE_PP_FE_57(m, x, ...) m(x) STATE_PP_EXPAND(STATE_PP_FE_56(m, __VA_ARGS__))
#define STATE_PP_FE_58(m, x, ...) m(x) STATE_PP_EXPAND(STATE_PP_FE_57(m, __VA_ARGS__))
#define STATE_PP_FE_59(m, x, ...) m(x) STATE_PP_EXPAND(STATE_PP_FE_58(m, __VA_ARGS__))
#define STATE_PP_FE_60(m, x, ...) m(x) STATE_PP_EXPAND(STATE_PP_FE_59(m, __VA_ARGS__))
#define STATE_PP_FE_61(m, x, ...) m(x) STATE_PP_EXPAND(STATE_PP_FE_60(m, __VA_ARGS__))
#define STATE_PP_FE_62(m, x, ...) m(x) STATE_PP_EXPAND(STATE_PP_FE_61(m, __VA_ARGS__))
#define STATE_PP_FE_63(m, x, ...) m(x) STATE_PP_EXPAND(STATE_PP_FE_62(m, __VA_ARGS__))
#define STATE_PP_FE_64(m, x, ...) m(x) STATE_PP_EXPAND(STATE_PP_FE_63(m, __VA_ARGS__))
#define STATE_PP_GET_FE(_1,_2,_3,_4,_5,_6,_7,_8,_9,_10,_11,_12,_13,_14,_15,_16,_17,_18,_19,_20,_21,_22,_23,_24,_25,_26,_27,_28,_29,_30,_31,_32,_33,_34,_35,_36,_37,_38,_39,_40,_41,_42,_43,_44,_45,_46,_47,_48,_49,_50,_51,_52,_53,_54,_55,_56,_57,_58,_59,_60,_61,_62,_63,_64, NAME, ...) NAME
#define STATE_PP_FOR_EACH(m, ...) STATE_PP_EXPAND(STATE_PP_GET_FE(__VA_ARGS__, STATE_PP_FE_64, STATE_PP_FE_63, STATE_PP_FE_62, STATE_PP_FE_61, STATE_PP_FE_60, STATE_PP_FE_59, STATE_PP_FE_58, STATE_PP_FE_57, STATE_PP_FE_56, STATE_PP_FE_55, STATE_PP_FE_54, STATE_PP_FE_53, STATE_PP_FE_52, STATE_PP_FE_51, STATE_PP_FE_50, STATE_PP_FE_49, STATE_PP_FE_48, STATE_PP_FE_47, STATE_PP_FE_46, STATE_PP_FE_45, STATE_PP_FE_44, STATE_PP_FE_43, STATE_PP_FE_42, STATE_PP_FE_41, STATE_PP_FE_40, STATE_PP_FE_39, STATE_PP_FE_38, STATE_PP_FE_37, STATE_PP_FE_36, STATE_PP_FE_35, STATE_PP_FE_34, STATE_PP_FE_33, STATE_PP_FE_32, STATE_PP_FE_31, STATE_PP_FE_30, STATE_PP_FE_29, STATE_PP_FE_28, STATE_PP_FE_27, STATE_PP_FE_26, STATE_PP_FE_25, STATE_PP_FE_24, STATE_PP_FE_23, STATE_PP_FE_22, STATE_PP_FE_21, STATE_PP_FE_20, STATE_PP_FE_19, STATE_PP_FE_18, STATE_PP_FE_17, STATE_PP_FE_16, STATE_PP_FE_15, STATE_PP_FE_14, STATE_PP_FE_13, STATE_PP_FE_12, STATE_PP_FE_11, STATE_PP_FE_10, STATE_PP_FE_9, STATE_PP_FE_8, STATE_PP_FE_7, STATE_PP_FE_6, STATE_PP_FE_5, STATE_PP_FE_4, STATE_PP_FE_3, STATE_PP_FE_2, STATE_PP_FE_1, STATE_PP_NONE_)(m, __VA_ARGS__))

#define STATE_PP_FED_1(m, d, x) m(d, x)
#define STATE_PP_FED_2(m, d, x, ...) m(d, x) STATE_PP_EXPAND(STATE_PP_FED_1(m, d, __VA_ARGS__))
#define STATE_PP_FED_3(m, d, x, ...) m(d, x) STATE_PP_EXPAND(STATE_PP_FED_2(m, d, __VA_ARGS__))
#define STATE_PP_FED_4(m, d, x, ...) m(d, x) STATE_PP_EXPAND(STATE_PP_FED_3(m, d, __VA_ARGS__))
#define STATE_PP_FED_5(m, d, x, ...) m(d, x) STATE_PP_EXPAND(STATE_PP_FED_4(m, d, __VA_ARGS__))
#define STATE_PP_FED_6(m, d, x, ...) m(d, x) STATE_PP_EXPAND(STATE_PP_FED_5(m, d, __VA_ARGS__))
#define STATE_PP_FED_7(m, d, x, ...) m(d, x) STATE_PP_EXPAND(STATE_PP_FED_6(m, d, __VA_ARGS__))
#define STATE_PP_FED_8(m, d, x, ...) m(d, x) STATE_PP_EXPAND(STATE_PP_FED_7(m, d, __VA_ARGS__))
#define STATE_PP_FED_9(m, d, x, ...) m(d, x) STATE_PP_EXPAND(STATE_PP_FED_8(m, d, __VA_ARGS__))
#define STATE_PP_FED_10(m, d, x, ...) m(d, x) STATE_PP_EXPAND(STATE_PP_FED_9(m, d, __VA_ARGS__))
#define STATE_PP_FED_11(m, d, x, ...) m(d, x) STATE_PP_EXPAND(STATE_PP_FED_10(m, d, __VA_ARGS__))
#define STATE_PP_FED_12(m, d, x, ...) m(d, x) STATE_PP_EXPAND(STATE_PP_FED_11(m, d, __VA_ARGS__))
#define STATE_PP_FED_13(m, d, x, ...) m(d, x) STATE_PP_EXPAND(STATE_PP_FED_12(m, d, __VA_ARGS__))
#define STATE_PP_FED_14(m, d, x, ...) m(d, x) STATE_PP_EXPAND(STATE_PP_FED_13(m, d, __VA_ARGS__))
#define STATE_PP_FED_15(m, d, x, ...) m(d, x) STATE_PP_EXPAND(STATE_PP_FED_14(m, d, __VA_ARGS__))
#define STATE_PP_FED_16(m, d, x, ...) m(d, x) STATE_PP_EXPAND(STATE_PP_FED_15(m, d, __VA_ARGS__))
#define STATE_PP_FED_17(m, d, x, ...) m(d, x) STATE_PP_EXPAND(STATE_PP_FED_16(m, d, __VA_ARGS__))
#define STATE_PP_FED_18(m, d, x, ...) m(d, x) STATE_PP_EXPAND(STATE_PP_FED_17(m, d, __VA_ARGS__))
#define STATE_PP_FED_19(m, d, x, ...) m(d, x) STATE_PP_EXPAND(STATE_PP_FED_18(m, d, __VA_ARGS__))
#define STATE_PP_FED_20(m, d, x, ...) m(d, x) STATE_PP_EXPAND(STATE_PP_FED_19(m, d, __VA_ARGS__))
#define STATE_PP_FED_21(m, d, x, ...) m(d, x) STATE_PP_EXPAND(STATE_PP_FED_20(m, d, __VA_ARGS__))
#define STATE_PP_FED_22(m, d, x, ...) m(d, x) STATE_PP_EXPAND(STATE_PP_FED_21(m, d, __VA_ARGS__))
#define STATE_PP_FED_23(m, d, x, ...) m(d, x) STATE_PP_EXPAND(STATE_PP_FED_22(m, d, __VA_ARGS__))
#define STATE_PP_FED_24(m, d, x, ...) m(d, x) STATE_PP_EXPAND(STATE_PP_FED_23(m, d, __VA_ARGS__))
#define STATE_PP_FED_25(m, d, x, ...) m(d, x) STATE_PP_EXPAND(STATE_PP_FED_24(m, d, __VA_ARGS__))
#define STATE_PP_FED_26(m, d, x, ...) m(d, x) STATE_PP_EXPAND(STATE_PP_FED_25(m, d, __VA_ARGS__))
#define STATE_PP_FED_27(m, d, x, ...) m(d, x) STATE_PP_EXPAND(STATE_PP_FED_26(m, d, __VA_ARGS__))
#define STATE_PP_FED_28(m, d, x, ...) m(d, x) STATE_PP_EXPAND(STATE_PP_FED_27(m, d, __VA_ARGS__))
#define STATE_PP_FED_29(m, d, x, ...) m(d, x) STATE_PP_EXPAND(STATE_PP_FED_28(m, d, __VA_ARGS__))
#define STATE_PP_FED_30(m, d, x, ...) m(d, x) STATE_PP_EXPAND(STATE_PP_FED_29(m, d, __VA_ARGS__))
#define STATE_PP_FED_31(m, d, x, ...) m(d, x) STATE_PP_EXPAND(STATE_PP_FED_30(m, d, __VA_ARGS__))
#define STATE_PP_FED_32(m, d, x, ...) m(d, x) STATE_PP_EXPAND(STATE_PP_FED_31(m, d, __VA_ARGS__))
#define STATE_PP_FED_33(m, d, x, ...) m(d, x) STATE_PP_EXPAND(STATE_PP_FED_32(m, d, __VA_ARGS__))
#define STATE_PP_FED_34(m, d, x, ...) m(d, x) STATE_PP_EXPAND(STATE_PP_FED_33(m, d, __VA_ARGS__))
#define STATE_PP_FED_35(m, d, x, ...) m(d, x) STATE_PP_EXPAND(STATE_PP_FED_34(m, d, __VA_ARGS__))
#define STATE_PP_FED_36(m, d, x, ...) m(d, x) STATE_PP_EXPAND(STATE_PP_FED_35(m, d, __VA_ARGS__))
#define STATE_PP_FED_37(m, d, x, ...) m(d, x) STATE_PP_EXPAND(STATE_PP_FED_36(m, d, __VA_ARGS__))
#define STATE_PP_FED_38(m, d, x, ...) m(d, x) STATE_PP_EXPAND(STATE_PP_FED_37(m, d, __VA_ARGS__))
#define STATE_PP_FED_39(m, d, x, ...) m(d, x) STATE_PP_EXPAND(STATE_PP_FED_38(m, d, __VA_ARGS__))
#define STATE_PP_FED_40(m, d, x, ...) m(d, x) STATE_PP_EXPAND(STATE_PP_FED_39(m, d, __VA_ARGS__))
#define STATE_PP_FED_41(m, d, x, ...) m(d, x) STATE_PP_EXPAND(STATE_PP_FED_40(m, d, __VA_ARGS__))
#define STATE_PP_FED_42(m, d, x, ...) m(d, x) STATE_PP_EXPAND(STATE_PP_FED_41(m, d, __VA_ARGS__))
#define STATE_PP_FED_43(m, d, x, ...) m(d, x) STATE_PP_EXPAND(STATE_PP_FED_42(m, d, __VA_ARGS__))
#define STATE_PP_FED_44(m, d, x, ...) m(d, x) STATE_PP_EXPAND(STATE_PP_FED_43(m, d, __VA_ARGS__))
#define STATE_PP_FED_45(m, d, x, ...) m(d, x) STATE_PP_EXPAND(STATE_PP_FED_44(m, d, __VA_ARGS__))
#define STATE_PP_FED_46(m, d, x, ...) m(d, x) STATE_PP_EXPAND(STATE_PP_FED_45(m, d, __VA_ARGS__))
#define STATE_PP_FED_47(m, d, x, ...) m(d, x) STATE_PP_EXPAND(STATE_PP_FED_46(m, d, __VA_ARGS__))
#define STATE_PP_FED_48(m, d, x, ...) m(d, x) STATE_PP_EXPAND(STATE_PP_FED_47(m, d, __VA_ARGS__))
#define STATE_PP_FED_49(m, d, x, ...) m(d, x) STATE_PP_EXPAND(STATE_PP_FED_48(m, d, __VA_ARGS__))
#define STATE_PP_FED_50(m, d, x, ...) m(d, x) STATE_PP_EXPAND(STATE_PP_FED_49(m, d, __VA_ARGS__))
#define STATE_PP_FED_51(m, d, x, ...) m(d, x) STATE_PP_EXPAND(STATE_PP_FED_50(m, d, __VA_ARGS__))
#define STATE_PP_FED_52(m, d, x, ...) m(d, x) STATE_PP_EXPAND(STATE_PP_FED_51(m, d, __VA_ARGS__))
#define STATE_PP_FED_53(m, d, x, ...) m(d, x) STATE_PP_EXPAND(STATE_PP_FED_52(m, d, __VA_ARGS__))
#define STATE_PP_FED_54(m, d, x, ...) m(d, x) STATE_PP_EXPAND(STATE_PP_FED_53(m, d, __VA_ARGS__))
#define STATE_PP_FED_55(m, d, x, ...) m(d, x) STATE_PP_EXPAND(STATE_PP_FED_54(m, d, __VA_ARGS__))
#define STATE_PP_FED_56(m, d, x, ...) m(d, x) STATE_PP_EXPAND(STATE_PP_FED_55(m, d, __VA_ARGS__))
#define STATE_PP_FED_57(m, d, x, ...) m(d, x) STATE_PP_EXPAND(STATE_PP_FED_56(m, d, __VA_ARGS__))
#define STATE_PP_FED_58(m, d, x, ...) m(d, x) STATE_PP_EXPAND(STATE_PP_FED_57(m, d, __VA_ARGS__))
#define STATE_PP_FED_59(m, d, x, ...) m(d, x) STATE_PP_EXPAND(STATE_PP_FED_58(m, d, __VA_ARGS__))
#define STATE_PP_FED_60(m, d, x, ...) m(d, x) STATE_PP_EXPAND(STATE_PP_FED_59(m, d, __VA_ARGS__))
#define STATE_PP_FED_61(m, d, x, ...) m(d, x) STATE_PP_EXPAND(STATE_PP_FED_60(m, d, __VA_ARGS__))
#define STATE_PP_FED_62(m, d, x, ...) m(d, x) STATE_PP_EXPAND(STATE_PP_FED_61(m, d, __VA_ARGS__))
#define STATE_PP_FED_63(m, d, x, ...) m(d, x) STATE_PP_EXPAND(STATE_PP_FED_62(m, d, __VA_ARGS__))
#define STATE_PP_FED_64(m, d, x, ...) m(d, x) STATE_PP_EXPAND(STATE_PP_FED_63(m, d, __VA_ARGS__))
#define STATE_PP_FOR_EACH_NS(d, m, ...) STATE_PP_EXPAND(STATE_PP_GET_FE(__VA_ARGS__, STATE_PP_FED_64, STATE_PP_FED_63, STATE_PP_FED_62, STATE_PP_FED_61, STATE_PP_FED_60, STATE_PP_FED_59, STATE_PP_FED_58, STATE_PP_FED_57, STATE_PP_FED_56, STATE_PP_FED_55, STATE_PP_FED_54, STATE_PP_FED_53, STATE_PP_FED_52, STATE_PP_FED_51, STATE_PP_FED_50, STATE_PP_FED_49, STATE_PP_FED_48, STATE_PP_FED_47, STATE_PP_FED_46, STATE_PP_FED_45, STATE_PP_FED_44, STATE_PP_FED_43, STATE_PP_FED_42, STATE_PP_FED_41, STATE_PP_FED_40, STATE_PP_FED_39, STATE_PP_FED_38, STATE_PP_FED_37, STATE_PP_FED_36, STATE_PP_FED_35, STATE_PP_FED_34, STATE_PP_FED_33, STATE_PP_FED_32, STATE_PP_FED_31, STATE_PP_FED_30, STATE_PP_FED_29, STATE_PP_FED_28, STATE_PP_FED_27, STATE_PP_FED_26, STATE_PP_FED_25, STATE_PP_FED_24, STATE_PP_FED_23, STATE_PP_FED_22, STATE_PP_FED_21, STATE_PP_FED_20, STATE_PP_FED_19, STATE_PP_FED_18, STATE_PP_FED_17, STATE_PP_FED_16, STATE_PP_FED_15, STATE_PP_FED_14, STATE_PP_FED_13, STATE_PP_FED_12, STATE_PP_FED_11, STATE_PP_FED_10, STATE_PP_FED_9, STATE_PP_FED_8, STATE_PP_FED_7, STATE_PP_FED_6, STATE_PP_FED_5, STATE_PP_FED_4, STATE_PP_FED_3, STATE_PP_FED_2, STATE_PP_FED_1, STATE_PP_NONE_)(m, d, __VA_ARGS__))
#define STATE_PP_UNPAREN(...) __VA_ARGS__
// STATE_PP_NONE_: keeps the variadic tail of STATE_PP_GET_FE non-empty in C++17 -pedantic mode.

#define STATE_VAR(name, ...) (name, __VA_ARGS__)
#define STATE_PP_VAR_ENUM(t) STATE_PP_EXPAND(STATE_PP_VAR_ENUM_I t)
#define STATE_PP_VAR_ENUM_I(name, ...) name,
#define STATE_PP_PREPEND(d, t) (d, STATE_PP_UNPAREN t)
#define STATE_PP_VAR_MEMBER(ns, t) STATE_PP_EXPAND(STATE_PP_VAR_MEMBER_I STATE_PP_PREPEND(ns, t))
#define STATE_PP_VAR_MEMBER_I(ns, name, ...) \
    static constexpr ::reflectstate::Var<Id::name, ns::StateVarType_<Id::name>::type> name{};
// Evaluate each value type outside the generated descriptor struct in a
// specialization selected by enum ID. This keeps STATE_VAR(Mode, Mode) valid:
// a state variable may have the same name as its C++ type without causing name
// lookup collisions inside the generated struct.
#define STATE_PP_VAR_TYPE(t) STATE_PP_EXPAND(STATE_PP_VAR_TYPE_I t)
#define STATE_PP_VAR_TYPE_I(name, ...) \
    template <> struct StateVarType_<StateVarId_::name> { using type = __VA_ARGS__; };
#define STATE_PP_VAR_VISIT(t) STATE_PP_EXPAND(STATE_PP_VAR_VISIT_I t)
#define STATE_PP_VAR_VISIT_I(name, ...) f(name, #name);

#define STATE_VARIABLES(Name, ...)                                                    \
    enum class Name##_Id : std::uint16_t { STATE_PP_FOR_EACH(STATE_PP_VAR_ENUM, __VA_ARGS__) Count }; \
    namespace Name##_Types {                                                        \
        using StateVarId_ = Name##_Id;                                                \
        template <StateVarId_> struct StateVarType_;                                    \
        STATE_PP_FOR_EACH(STATE_PP_VAR_TYPE, __VA_ARGS__)                               \
    }                                                                               \
    struct Name {                                                                   \
        using Id = Name##_Id;                                                       \
        STATE_PP_FOR_EACH_NS(Name##_Types, STATE_PP_VAR_MEMBER, __VA_ARGS__)            \
        /* Value type declared for this ID by STATE_VAR */                            \
        template <Id K>                                                             \
        using TypeOf = typename Name##_Types::StateVarType_<K>::type;                 \
        /* Call f(variable, "Name") for every variable in declaration order */       \
        template <class F>                                                          \
        static void forEach(F&& f) {                                                \
            STATE_PP_FOR_EACH(STATE_PP_VAR_VISIT, __VA_ARGS__)                          \
        }                                                                           \
    };

using StateError = reflectstate::Error;
using StateSetStatus = reflectstate::SetStatus;
using StateSetResult = reflectstate::SetResult;


// -----------------------------------------------------------------------------
//  StateManager
// -----------------------------------------------------------------------------
template <class Variables,
          std::size_t StorageBytes = 256,
          std::size_t MaxListeners = 16,
          class LockPolicy = reflectstate::NoLock>
class StateManager {
    static_assert(reflectstate::detail::IsVariables<Variables>::value,
                  "StateManager<Variable, ...>: Variable must be defined with STATE_VARIABLES(Variable, ...)");

public:
    // Enum generated by STATE_VARIABLES (Variable_Id).
    using Key = typename Variables::Id;

private:
    // IDs are contiguous from 0 to Count, so slot index == ID.
    static constexpr std::size_t KeyCount = static_cast<std::size_t>(Key::Count);
    static_assert(StorageBytes > 0 && StorageBytes <= 0xFFFF, "StorageBytes: 1..65535");
    static_assert(MaxListeners < 0xFFFF, "MaxListeners too large");

    // C++ does not allow zero-length arrays. MaxListeners == 0 therefore keeps
    // one unused physical slot; addListener still enforces the configured limit.
    static constexpr std::size_t kListenerSlots = MaxListeners ? MaxListeners : 1;
    static_assert(STATE_MAX_DISPATCH_DEPTH > 0 && STATE_MAX_DISPATCH_DEPTH < 255,
                  "STATE_MAX_DISPATCH_DEPTH: 1..254");

    using Error = reflectstate::Error;

public:
    template <class T>
    using Callback = void (*)(const T& oldValue, const T& newValue);
    template <class T>
    using CallbackCtx = void (*)(void* ctx, const T& oldValue, const T& newValue);
    // true means "equal", therefore no relevant change
    template <class T>
    using Comparator = bool (*)(const T& a, const T& b);

    using SetResult = reflectstate::SetResult;
    using SetStatus = reflectstate::SetStatus;

    StateManager() = default;
    StateManager(const StateManager&) = delete;
    StateManager& operator=(const StateManager&) = delete;

    ~StateManager() {
        for (auto& e : entries_)
            if (e.type && e.destroy) e.destroy(pool_ + e.offset);
    }

    // ------------------------------------------------------- Registration --
    // All public functions take a typed key generated by STATE_VARIABLES.
    // The declared value type is inferred automatically. Assignable input values
    // are converted like a normal C++ assignment. A mismatched callback type,
    // a key from another STATE_VARIABLES set, or another type mismatch is a
    // compile-time error.

    // Register one state variable with T{} or with the supplied initial value.
    template <auto K, class T>
    bool add(reflectstate::Var<K, T> v) {
        checkVar(v);
        static_assert(std::is_default_constructible<T>::value,
                      "add(Variable): type requires a default constructor -> use add(Variable, initialValue)");
        return addImpl<T>(K, T{});
    }
    template <auto K, class T, class U>
    bool add(reflectstate::Var<K, T> v, const U& initial) {
        checkVar(v);
        const T value = initial;
        return addImpl<T>(K, value);
    }

    // Register every state variable that is still missing using T{}.
    // Already registered variables stay unchanged, allowing selected variables
    // to receive custom initial values before addAll().
    // Returns true when all variables are registered. On failure, for example a
    // non-default-constructible type or insufficient StorageBytes, lastErrorCode()
    // describes the reason.
    bool addAll() {
        bool ok = true;
        Variables::forEach([&](auto var, const char*) { ok = this->addIfMissing(var) && ok; });
        return ok;
    }

    // Remove one state variable completely: listeners, value/destructor and entry.
    // The pool is intentionally simple and does not compact middle holes. Removing
    // values at the end can lower the used boundary; when no values remain the
    // pool becomes completely empty again. Safe to call from a callback.
    template <auto K, class T>
    bool remove(reflectstate::Var<K, T> v) {
        checkVar(v);
        return removeImpl(K);
    }

    // Remove everything: values/destructors, listeners, comparators and tolerances,
    // and reset pool/error state. Not allowed while any callbacks are dispatching,
    // including on another core, because clear() would invalidate active entries
    // and listener nodes.
    bool clear() {
        Guard g(*this);
        if (dispatchDepth_ > 0)
            return error(Error::InDispatch, "state.clear: not allowed while callbacks are running");
        for (auto& e : entries_) {
            if (e.type) e.destroy(pool_ + e.offset);
            e = Entry{};
        }
        for (auto& l : listeners_) l = Listener{};
        used_ = 0;
        entryCount_ = 0;
        dirty_ = false;
        lastErrorCode_ = Error::None;
        lastError_ = nullptr;
        pendingReport_ = nullptr;
        return true;
    }

    template <auto K, class T>
    bool has(reflectstate::Var<K, T> v) const {
        checkVar(v);
        Guard g(*this);
        return isRegistered(K);
    }

    // ---------------------------------------------------------------- Values --
    // Return a copy so reads remain atomic under the selected lock policy.
    // If the variable is not registered, get() returns T{} and sets KeyNotFound.
    // Use tryGet() when failure must be detected explicitly.
    template <auto K, class T>
    T get(reflectstate::Var<K, T> v) const {
        checkVar(v);
        static_assert(std::is_default_constructible<T>::value,
                      "get(Variable): type has no default constructor -> use tryGet() or getOr()");
        return getImpl<T>(K);
    }
    template <auto K, class T>
    bool tryGet(reflectstate::Var<K, T> v, T& out) const {
        checkVar(v);
        return tryGetImpl<T>(K, out);
    }
    // Return the stored value or a fallback; no default constructor is required.
    template <auto K, class T>
    T getOr(reflectstate::Var<K, T> v, const reflectstate::detail::NoDeduce<T>& fallback) const {
        checkVar(v);
        return getOrImpl<T>(K, fallback);
    }

    // Set the value and notify listeners only for a relevant change.
    //
    // Listeners receive copies of old/new values, never references to internal
    // storage. If a listener calls set() recursively on the same variable, the
    // remaining listeners of the outer dispatch still receive the original
    // change. Dispatch order is depth-first.
    //
    // When STATE_MAX_DISPATCH_DEPTH is reached, the new value is not stored and
    // Error::MaxDepth is returned. This preserves the rule that every stored
    // reported change can be dispatched.
    //
    // false means unchanged, silently stored because of tolerance, or error.
    // Use trySet() to distinguish these cases.
    template <auto K, class T, class U>
    bool set(reflectstate::Var<K, T> v, const U& value) {
        return trySet(v, value).changed();
    }

    // Like set(), but reports exactly what happened:
    //   auto r = state.trySet(Variable::Interval, 500);
    //   switch (r.status) {
    //     case StateSetStatus::Changed:      ... changed and listeners dispatched
    //     case StateSetStatus::Unchanged:    ... value already considered equal
    //     case StateSetStatus::StoredSilent: ... stored within float tolerance
    //     case StateSetStatus::Error:        ... inspect r.error
    //   }
    // r.error belongs to this exact call; lastErrorCode() is updated as well.
    template <auto K, class T, class U>
    [[nodiscard]] SetResult trySet(reflectstate::Var<K, T> v, const U& value) {
        checkVar(v);
        const T converted = value;
        return trySetImpl<T>(K, converted);
    }

    // Store without dispatching listeners; also becomes the new tolerance baseline.
    template <auto K, class T, class U>
    bool setSilent(reflectstate::Var<K, T> v, const U& value) {
        checkVar(v);
        const T converted = value;
        return setSilentImpl<T>(K, converted);
    }

    // Copy, modify through a callable, then write back as one atomic operation:
    //   state.update(Variable::Motor, [](MotorData& m) { m.power = 550; });
    // The callable runs while the lock is held, so keep it short and avoid state
    // calls unless the selected lock policy is recursive.
    template <auto K, class T, class F>
    bool update(reflectstate::Var<K, T> v, F&& fn) {
        return tryUpdate(v, static_cast<F&&>(fn)).changed();
    }
    template <auto K, class T, class F>
    [[nodiscard]] SetResult tryUpdate(reflectstate::Var<K, T> v, F&& fn) {
        checkVar(v);
        return tryUpdateImpl<T>(K, static_cast<F&&>(fn));
    }

    // Dispatch listeners even when the value did not change (old == new).
    template <auto K, class T>
    bool notify(reflectstate::Var<K, T> v) {
        checkVar(v);
        return notifyImpl(K);
    }

    // float/double: dispatch only when |new - lastReported| > tolerance.
    template <auto K, class T>
    bool setTolerance(reflectstate::Var<K, T> v, double tolerance) {
        checkVar(v);
        static_assert(std::is_floating_point<T>::value, "setTolerance is only available for float/double variables");
        return setToleranceImpl<T>(K, static_cast<T>(tolerance));
    }

    // Custom comparator for non-float types; use setTolerance() for float/double.
    // cmp(a, b) == true means "equal": set() does not store or notify and returns
    // Unchanged. The next set() therefore compares against the last reported value,
    // which gives tolerance-like comparators hysteresis behavior instead of letting
    // many small steps accumulate unnoticed.
    //
    // This also supports foreign types without REFLECT() or operator==. They can
    // be registered normally, but set() reports Error::NotComparable until a
    // comparator is installed. The comparator runs while the lock is held.
    // nullptr restores the default comparison.
    //
    //   state.setComparator(Variable::Motor, [](const MotorData& a, const MotorData& b) {
    //       return reflectstate::approxEqual(a, b, 0.05);
    //   });
    template <auto K, class T>
    bool setComparator(reflectstate::Var<K, T> v, reflectstate::detail::NoDeduce<Comparator<T>> cmp) {
        checkVar(v);
        static_assert(!std::is_floating_point<T>::value,
                      "setComparator: use setTolerance() for float/double");
        return setComparatorImpl<T>(K, cmp);
    }

    // ------------------------------------------------------------ Callbacks --

    // Free function or captureless lambda:
    //   state.onChange(Variable::Interval, intervalChanged);
    //   state.onChange(Variable::Interval, [](const int& oldV, const int& newV) { ... });
    template <auto K, class T>
    bool onChange(reflectstate::Var<K, T> v, reflectstate::detail::NoDeduce<Callback<T>> cb) {
        checkVar(v);
        return onChangeImpl<T>(K, cb);
    }
    // Function with an explicit context pointer.
    template <auto K, class T>
    bool onChange(reflectstate::Var<K, T> v, reflectstate::detail::NoDeduce<CallbackCtx<T>> cb, void* ctx) {
        checkVar(v);
        return onChangeImpl<T>(K, cb, ctx);
    }
    // Member function without std::function or extra dynamic storage:
    //   state.onChange<&MyClass::valueChanged>(Variable::Value, this);
    // with void MyClass::valueChanged(const int& oldV, const int& newV) [const].
    template <auto Method, auto K, class T>
    bool onChange(reflectstate::Var<K, T> v,
                  typename reflectstate::detail::MemberCallback<decltype(Method)>::Object* obj) {
        checkVar(v);
        static_assert(std::is_same<typename reflectstate::detail::MemberCallback<decltype(Method)>::Value, T>::value,
                      "onChange<&Class::method>(Variable, obj): callback parameter type does not match the variable");
        return onChangeMemberImpl<Method>(K, obj);
    }

    template <auto K, class T>
    bool removeCallback(reflectstate::Var<K, T> v, reflectstate::detail::NoDeduce<Callback<T>> cb) {
        checkVar(v);
        return removeCallbackImpl<T>(K, cb);
    }
    template <auto K, class T>
    bool removeCallback(reflectstate::Var<K, T> v, reflectstate::detail::NoDeduce<CallbackCtx<T>> cb, void* ctx) {
        checkVar(v);
        return removeCallbackImpl<T>(K, cb, ctx);
    }
    template <auto Method, auto K, class T>
    bool removeCallback(reflectstate::Var<K, T> v,
                        typename reflectstate::detail::MemberCallback<decltype(Method)>::Object* obj) {
        checkVar(v);
        return removeCallbackMemberImpl<Method>(K, obj);
    }
    template <auto K, class T>
    bool removeAllCallbacks(reflectstate::Var<K, T> v) {
        checkVar(v);
        return removeAllCallbacksImpl(K);
    }

    // -------------------------------------------------------------- Locking --

    // Group multiple calls into one atomic block. The lock policy must be
    // recursive; IrqLock, PicoLock and Esp32Lock are:
    //   { auto g = state.scopedLock(); auto a = state.get(A); state.set(B, a); }
    class ScopedLock {
    public:
        explicit ScopedLock(const StateManager& m) : m_(m) { m_.acquire(); }
        ~ScopedLock() { m_.release(); }
        ScopedLock(const ScopedLock&) = delete;
        ScopedLock& operator=(const ScopedLock&) = delete;

    private:
        const StateManager& m_;
    };

    ScopedLock scopedLock() const { return ScopedLock(*this); }
    void lock() const { acquire(); }
    void unlock() const { release(); }

    // ----------------------------------------------------------- Information --

    std::size_t entryCount() const {
        Guard g(*this);
        return entryCount_;
    }
    static constexpr std::size_t entryCapacity() { return KeyCount; }

    std::size_t storageUsed() const {
        Guard g(*this);
        return used_;
    }
    std::size_t storageFree() const {
        Guard g(*this);
        return StorageBytes - used_;
    }
    static constexpr std::size_t storageCapacity() { return StorageBytes; }

    std::size_t listenerCount() const {
        Guard g(*this);
        std::size_t n = 0;
        for (const auto& l : listeners_)
            if (l.fn && !(l.flags & kDead)) ++n;
        return n;
    }
    static constexpr std::size_t listenerCapacity() { return MaxListeners; }

    // Last sticky error; see the file header.
    Error lastErrorCode() const {
        Guard g(*this);
        return lastErrorCode_;
    }
    // Human-readable static context string, or nullptr when no error is stored.
    const char* lastError() const {
        Guard g(*this);
        return lastError_;
    }
    // Clear the last error. This also discards a pending STATE_ON_ERROR report,
    // for example while an explicit scopedLock() block is still active.
    void clearError() {
        Guard g(*this);
        lastErrorCode_ = Error::None;
        lastError_ = nullptr;
        pendingReport_ = nullptr;
    }

private:
    using RawFn = void (*)();
    static constexpr std::uint16_t kNone = 0xFFFF;

    // Flags used to mutate the listener list safely during callback dispatch:
    //   kDead    : removed; no longer called, slot retained until dispatch ends
    //   kPending : added during dispatch; becomes active after collection
    static constexpr std::uint8_t kDead = 0x01;
    static constexpr std::uint8_t kPending = 0x02;

    struct Entry {
        reflectstate::detail::TypeId type = nullptr;  // nullptr means the state variable is not registered
        std::uint16_t offset = 0;
        std::uint16_t size = 0;
        std::uint16_t head = kNone;
        void (*notify)(StateManager&, std::size_t) = nullptr;
        void (*destroy)(void*) = nullptr;
        RawFn compare = nullptr;    // Comparator<T> or nullptr (not used for float/double)
        double tolerance = 0.0;     // float/double only
        double lastNotified = 0.0;  // float/double only
    };

    struct Listener {
        RawFn fn = nullptr;
        void* ctx = nullptr;
        std::uint16_t next = kNone;
        bool withCtx = false;
        std::uint8_t flags = 0;
    };

    template <auto K, class T>
    static constexpr void checkVar(reflectstate::Var<K, T>) {
        static_assert(std::is_same<decltype(K), Key>::value,
                      "variable belongs to a different STATE_VARIABLES set than this StateManager");
        // Also rejects a manually constructed reflectstate::Var<Id::X, OtherType>:
        // its type must exactly match the declaration in STATE_VAR.
        if constexpr (std::is_same<decltype(K), Key>::value)
            static_assert(std::is_same<T, typename Variables::template TypeOf<K>>::value,
                          "type does not match the variable declaration in STATE_VARIABLES");
    }

    struct Guard {
        explicit Guard(const StateManager& m) : m_(m) { m_.acquire(); }
        ~Guard() { m_.release(); }
        Guard(const Guard&) = delete;
        Guard& operator=(const Guard&) = delete;
        const StateManager& m_;
    };

    // ---- Key -> slot -----------------------------------------------------------
    // STATE_VARIABLES assigns contiguous IDs starting at zero, so the slot is ID.
    static std::size_t slotOf(Key key) { return static_cast<std::size_t>(key); }

    bool isRegistered(Key key) const { return entries_[slotOf(key)].type != nullptr; }

    // Slot of a registered variable, otherwise KeyCount.
    std::size_t indexOf(Key key) const { return isRegistered(key) ? slotOf(key) : KeyCount; }

    // End offset of the last registered value, or 0 when none exist.
    std::size_t poolEnd() const {
        std::size_t end = 0;
        for (const auto& e : entries_) {
            if (!e.type) continue;
            const std::size_t last = static_cast<std::size_t>(e.offset) + e.size;
            if (last > end) end = last;
        }
        return end;
    }


    // ---- Implementation (key + type; reachable only through typed public API) --
    // Register a key with its type and initial value, once per key.
    template <class T>
    bool addImpl(Key key, const T& initial) {
        static_assert(!std::is_array<T>::value, "C arrays are not supported directly: use std::array");
        static_assert(!std::is_reference<T>::value && std::is_same<T, std::remove_cv_t<T>>::value,
                      "T must not be const or a reference");
        static_assert(std::is_copy_constructible<T>::value && std::is_copy_assignable<T>::value,
                      "T must be copyable");
        static_assert(alignof(T) <= alignof(std::max_align_t), "alignment is too large");
        static_assert(sizeof(T) <= StorageBytes,
                      "variable is larger than the entire pool: increase StorageBytes");

        Guard g(*this);
        if (isRegistered(key)) return error(Error::AlreadyRegistered, "state.add: variable already registered");
        const std::size_t i = slotOf(key);

        const std::size_t off = (used_ + alignof(T) - 1) & ~(alignof(T) - 1);
        if (off + sizeof(T) > StorageBytes) return error(Error::StorageFull, "state.add: StorageBytes too small");

        ::new (static_cast<void*>(pool_ + off)) T(initial);
        used_ = off + sizeof(T);

        Entry& e = entries_[i];
        e = Entry{};
        e.type = reflectstate::detail::typeId<T>();
        e.offset = static_cast<std::uint16_t>(off);
        e.size = static_cast<std::uint16_t>(sizeof(T));
        e.notify = &notifyThunk<T>;
        e.destroy = &destroyThunk<T>;
        if constexpr (std::is_floating_point<T>::value) e.lastNotified = static_cast<double>(initial);
        ++entryCount_;
        return true;
    }

    // Remove a key completely: listeners, value/destructor and entry.
    // The simple pool does not compact holes in the middle. Removing values at
    // the end can lower the used boundary; when no values remain the pool becomes
    // fully empty again. Safe to call from a callback.
    bool removeImpl(Key key) {
        Guard g(*this);
        const std::size_t i = indexOf(key);
        if (i >= KeyCount) return error(Error::KeyNotFound, "state.remove: variable not registered");
        detachListeners(i);
        Entry& e = entries_[i];
        e.destroy(pool_ + e.offset);
        e = Entry{};
        --entryCount_;
        used_ = poolEnd();
        return true;
    }

    // ---------------------------------------------------------------- Values --
    // Return a copy. On error, getImpl() returns T{} and stores an error code.
    // Use tryGet() when failure must be detected explicitly. Returning by value
    // keeps the read atomic under the selected lock policy.
    template <class T>
    T getImpl(Key key) const {
        static_assert(std::is_default_constructible<T>::value,
                      "get(Variable): type has no default constructor -> use tryGet() or getOr()");
        Guard g(*this);
        std::size_t i;
        if (const T* p = find<T>(key, i)) return *p;
        return T{};
    }

    template <class T>
    bool tryGetImpl(Key key, T& out) const {
        Guard g(*this);
        std::size_t i;
        const T* p = find<T>(key, i);
        if (!p) return false;
        out = *p;
        return true;
    }

    // Return the stored value or the supplied fallback; no default constructor required.
    template <class T>
    T getOrImpl(Key key, const T& fallback) const {
        Guard g(*this);
        std::size_t i;
        if (const T* p = find<T>(key, i)) return *p;
        return fallback;
    }

    // Set the value and dispatch listeners only for a relevant change.
    //
    // Listeners receive copies of old/new values, never references to internal
    // storage. Recursive set() calls on the same key do not alter the old/new
    // snapshot seen by the remaining listeners of the outer dispatch.
    // Dispatch order is depth-first.
    //
    // If STATE_MAX_DISPATCH_DEPTH is reached, the value is not stored and
    // Error::MaxDepth is returned, preventing runaway recursion.
    //
    // false may mean unchanged, silently stored within tolerance, or error.
    // trySet() returns the detailed result for callers that need to distinguish.
    template <class T>
    SetResult trySetImpl(Key key, const T& value) {
        Guard g(*this);
        return setLocked<T>(key, value);
    }

    // Store without listener dispatch; also becomes the new tolerance baseline.
    template <class T>
    bool setSilentImpl(Key key, const T& value) {
        Guard g(*this);
        std::size_t i;
        T* p = find<T>(key, i);
        if (!p) return false;
        *p = value;
        if constexpr (std::is_floating_point<T>::value)
            entries_[i].lastNotified = static_cast<double>(value);
        return true;
    }

    // Copy, modify through a callable, then write back as one atomic operation.
    // The callable runs while the lock is held, so keep it short and avoid state
    // calls unless the selected lock policy is recursive.
    // tryUpdate() returns the same detailed result categories as trySet().
    template <class T, class F>
    SetResult tryUpdateImpl(Key key, F&& fn) {
        Guard g(*this);
        std::size_t i;
        const T* p = find<T>(key, i);
        if (!p) return {SetStatus::Error, lastErrorCode_};
        T copy = *p;
        fn(copy);
        return setLocked<T>(key, copy);
    }

    // Dispatch listeners even without a value change (old == new).
    bool notifyImpl(Key key) {
        Guard g(*this);
        const std::size_t i = indexOf(key);
        if (i >= KeyCount) return error(Error::KeyNotFound, "state.notify: variable not registered");
        if (entries_[i].head == kNone) return true;  // no listeners
        if (dispatchDepth_ >= STATE_MAX_DISPATCH_DEPTH)
            return error(Error::MaxDepth, "state.notify: maximum callback depth reached");
        entries_[i].notify(*this, i);
        return true;
    }

    // float/double: dispatch only when |new - lastReported| > tolerance.
    template <class T>
    bool setToleranceImpl(Key key, T tolerance) {
        static_assert(std::is_floating_point<T>::value, "setTolerance is only available for float/double");
        Guard g(*this);
        std::size_t i;
        if (!find<T>(key, i)) return false;
        entries_[i].tolerance = std::fabs(static_cast<double>(tolerance));
        return true;
    }

    // Custom comparison for a key. Use setTolerance() for float/double.
    // Foreign types without REFLECT() or operator== may still be registered;
    // set() reports Error::NotComparable until a comparator is installed.
    // cmp(a, b) == true means "equal", so set() neither stores nor notifies.
    // The comparator runs while the lock is held. nullptr restores the default.
    //
    //   bool motorEqual(const MotorData& a, const MotorData& b) {
    //       return reflectstate::approxEqual(a, b, 0.05);
    //   }
    //   state.setComparator(Variable::Motor, motorEqual);
    template <class T>
    bool setComparatorImpl(Key key, Comparator<T> cmp) {
        static_assert(!std::is_floating_point<T>::value,
                      "setComparator: use setTolerance() for float/double");
        Guard g(*this);
        std::size_t i;
        if (!find<T>(key, i)) return false;
        entries_[i].compare = reinterpret_cast<RawFn>(cmp);
        return true;
    }

    // ------------------------------------------------------------ Callbacks --

    // Free function or captureless lambda:
    //   state.onChange(Variable::Interval, intervalChanged);
    //   state.onChange(Variable::Interval, [](const int& oldV, const int& newV) { ... });
    template <class T>
    bool onChangeImpl(Key key, Callback<T> cb) {
        Guard g(*this);
        return addListener<T>(key, reinterpret_cast<RawFn>(cb), nullptr, false);
    }

    // Function with an explicit context pointer.
    template <class T>
    bool onChangeImpl(Key key, CallbackCtx<T> cb, void* ctx) {
        Guard g(*this);
        return addListener<T>(key, reinterpret_cast<RawFn>(cb), ctx, true);
    }

    // Member function without std::function or extra dynamic storage:
    //   state.onChange<&MyClass::valueChanged>(Variable::Value, this);
    // with void MyClass::valueChanged(const int& oldV, const int& newV) [const].
    template <auto Method>
    bool onChangeMemberImpl(Key key, typename reflectstate::detail::MemberCallback<decltype(Method)>::Object* obj) {
        using MC = reflectstate::detail::MemberCallback<decltype(Method)>;
        static_assert(MC::valid, "onChange<&Class::method>: expected void (const T&, const T&)");
        using T = typename MC::Value;
        Guard g(*this);
        return addListener<T>(key, reinterpret_cast<RawFn>(&memberBridge<Method>),
                              const_cast<void*>(static_cast<const void*>(obj)), true);
    }

    template <class T>
    bool removeCallbackImpl(Key key, Callback<T> cb) {
        Guard g(*this);
        return removeListener(key, reinterpret_cast<RawFn>(cb), nullptr, false);
    }

    template <class T>
    bool removeCallbackImpl(Key key, CallbackCtx<T> cb, void* ctx) {
        Guard g(*this);
        return removeListener(key, reinterpret_cast<RawFn>(cb), ctx, true);
    }

    template <auto Method>
    bool removeCallbackMemberImpl(Key key, typename reflectstate::detail::MemberCallback<decltype(Method)>::Object* obj) {
        Guard g(*this);
        return removeListener(key, reinterpret_cast<RawFn>(&memberBridge<Method>),
                              const_cast<void*>(static_cast<const void*>(obj)), true);
    }

    bool removeAllCallbacksImpl(Key key) {
        Guard g(*this);
        const std::size_t i = indexOf(key);
        if (i >= KeyCount) return error(Error::KeyNotFound, "state.removeAllCallbacks: variable not registered");
        detachListeners(i);
        return true;
    }

    template <auto K, class T>
    bool addIfMissing(reflectstate::Var<K, T> v) {
        {
            Guard g(*this);
            if (isRegistered(K)) return true;
        }
        if constexpr (std::is_default_constructible<T>::value) {
            return add(v);
        } else {
            Guard g(*this);
            return error(Error::NotDefaultConstructible,
                         "state.addAll: type has no default constructor - register it first with add(Variable, initialValue)");
        }
    }

    // ---- Errors ----------------------------------------------------------------
    // Called while locked: record only. Reporting happens from release()/fire()
    // after the lock has actually been released.
    bool error(Error code, const char* msg) const {
        lastErrorCode_ = code;
        lastError_ = msg;
        pendingReport_ = msg;
        return false;
    }

    static void report(const char* msg) {
        (void)msg;
        STATE_ON_ERROR(msg);
    }

    // ---- Lock recursion tracking ------------------------------------------------
    // guardDepth_ counts acquisitions by the current lock owner through Guard,
    // ScopedLock or lock(). It is modified only while locked. STATE_ON_ERROR is
    // reported only after the outermost acquisition releases the lock.
    void acquire() const {
        lock_.lock();
        ++guardDepth_;
    }

    void release() const {
        const char* msg = nullptr;
        if (--guardDepth_ == 0) {
            msg = pendingReport_;
            pendingReport_ = nullptr;
        }
        lock_.unlock();
        if (msg) report(msg);
    }

    // ---- Access helpers; lock must already be held -----------------------------
    template <class T>
    const T* find(Key key, std::size_t& i) const {
        i = indexOf(key);
        if (i >= KeyCount) {
            error(Error::KeyNotFound, "state: variable not registered");
            return nullptr;
        }
        return std::launder(reinterpret_cast<const T*>(pool_ + entries_[i].offset));
    }

    template <class T>
    T* find(Key key, std::size_t& i) {
        return const_cast<T*>(static_cast<const StateManager*>(this)->template find<T>(key, i));
    }

    template <class T>
    static bool floatChanged(T a, T b, double tol) {
        const bool na = std::isnan(a), nb = std::isnan(b);
        if (na || nb) return !(na && nb);
        if (tol <= 0.0) return a != b;
        return std::fabs(static_cast<double>(a) - static_cast<double>(b)) > tol;
    }

    SetResult fail(Error code, const char* msg) {
        error(code, msg);
        return {SetStatus::Error, code};
    }

    template <class T>
    SetResult setLocked(Key key, const T& value) {
        std::size_t i;
        T* p = find<T>(key, i);
        if (!p) return {SetStatus::Error, lastErrorCode_};  // while locked, this is our own error
        Entry& e = entries_[i];

        if constexpr (std::is_floating_point<T>::value) {
            const T next = value;  // copy: value may itself refer to *p
            const T last = static_cast<T>(e.lastNotified);
            if (!floatChanged(last, next, e.tolerance)) {
                // Exactly equal: nothing to do; otherwise store silently within tolerance.
                if (reflectstate::detail::equal(*p, next)) return {SetStatus::Unchanged, Error::None};
                *p = next;
                return {SetStatus::StoredSilent, Error::None};
            }
            if (e.head == kNone) {  // no listeners: no dispatch and no depth change
                *p = next;
                e.lastNotified = static_cast<double>(next);
                return {SetStatus::Changed, Error::None};
            }
            if (dispatchDepth_ >= STATE_MAX_DISPATCH_DEPTH)
                return fail(Error::MaxDepth, "state.set: maximum callback depth reached");
            *p = next;
            e.lastNotified = static_cast<double>(next);
            fire<T>(i, last, next);
            return {SetStatus::Changed, Error::None};
        } else {
            const auto cmp = reinterpret_cast<Comparator<T>>(e.compare);
            bool same = false;
            if (cmp) {
                same = cmp(*p, value);
            } else {
                bool ok = true;
                same = reflectstate::detail::equalImpl<false>(*p, value, 0.0, ok);
                if (!ok)
                    return fail(Error::NotComparable,
                                "state.set: type is not comparable - use REFLECT(), operator== or setComparator()");
            }
            if (same) return {SetStatus::Unchanged, Error::None};
            if (e.head == kNone) {  // no listeners: no copies and no depth change
                *p = value;
                return {SetStatus::Changed, Error::None};
            }
            if (dispatchDepth_ >= STATE_MAX_DISPATCH_DEPTH)
                return fail(Error::MaxDepth, "state.set: maximum callback depth reached");
            const T old = *p;
            *p = value;
            const T next = *p;  // snapshot independent of later set() calls
            fire<T>(i, old, next);
            return {SetStatus::Changed, Error::None};
        }
    }

    // ---- Dispatch ---------------------------------------------------------------
    // Called while the lock is held. The lock is released around each individual
    // callback. While dispatchDepth_ > 0, listener nodes are only marked, never
    // unlinked or freed, so the traversal remains valid even when callbacks or
    // another core mutate listeners. collect() cleans up after dispatch completes.
    // Callers check head != kNone first, so no-listener cases do not touch depth.
    template <class T>
    void fire(std::size_t i, const T& oldV, const T& newV) {
        ++dispatchDepth_;
        std::uint16_t li = entries_[i].head;
        while (li != kNone) {
            const Listener l = listeners_[li];
            if (l.fn && !(l.flags & (kDead | kPending))) {
                // Release here only when this Guard is the sole lock owner.
                // An outer scopedLock() keeps the lock held. Any pending error is
                // reported only after the lock is actually free.
                const bool releases = (guardDepth_ == 1);
                const char* msg = nullptr;
                if (releases) {
                    msg = pendingReport_;
                    pendingReport_ = nullptr;
                    guardDepth_ = 0;
                }
                lock_.unlock();
                if (msg) report(msg);
                if (l.withCtx)
                    reinterpret_cast<CallbackCtx<T>>(l.fn)(l.ctx, oldV, newV);
                else
                    reinterpret_cast<Callback<T>>(l.fn)(oldV, newV);
                lock_.lock();
                if (releases) guardDepth_ = 1;
            }
            li = listeners_[li].next;  // read after callback so newly appended nodes remain reachable
        }
        if (--dispatchDepth_ == 0 && dirty_) collect();
    }

    void collect() {
        // Unlink nodes marked dead from lists of still-registered keys.
        for (auto& e : entries_) {
            if (!e.type) continue;
            std::uint16_t* link = &e.head;
            while (*link != kNone) {
                Listener& l = listeners_[*link];
                if (l.flags & kDead) {
                    *link = l.next;
                } else {
                    link = &l.next;
                }
            }
        }
        // Free all marked slots, including slots from removed keys, and activate
        // listeners that were added as pending during dispatch.
        for (auto& l : listeners_) {
            if (l.flags & kDead)
                l = Listener{};
            else
                l.flags &= static_cast<std::uint8_t>(~kPending);
        }
        dirty_ = false;
    }

    template <class T>
    static void notifyThunk(StateManager& self, std::size_t i) {
        Entry& e = self.entries_[i];
        // Snapshot like set(): callbacks never receive internal storage references.
        const T v = *std::launder(reinterpret_cast<const T*>(self.pool_ + e.offset));
        if constexpr (std::is_floating_point<T>::value) {
            const T last = static_cast<T>(e.lastNotified);
            e.lastNotified = static_cast<double>(v);
            self.fire<T>(i, last, v);
        } else {
            self.fire<T>(i, v, v);
        }
    }

    template <class T>
    static void destroyThunk(void* p) {
        std::launder(reinterpret_cast<T*>(p))->~T();
    }

    template <auto Method>
    static void memberBridge(void* ctx,
                             const typename reflectstate::detail::MemberCallback<decltype(Method)>::Value& o,
                             const typename reflectstate::detail::MemberCallback<decltype(Method)>::Value& n) {
        using Obj = typename reflectstate::detail::MemberCallback<decltype(Method)>::Object;
        (static_cast<Obj*>(ctx)->*Method)(o, n);
    }

    // ---- Listener management; lock must already be held -----------------------
    template <class T>
    bool addListener(Key key, RawFn fn, void* ctx, bool withCtx) {
        if (!fn) return error(Error::NullCallback, "state.onChange: callback is null");
        std::size_t i;
        if (!find<T>(key, i)) return false;  // the variable must be registered with add() first

        std::uint16_t* link = &entries_[i].head;
        while (*link != kNone) {
            const Listener& l = listeners_[*link];
            if (!(l.flags & kDead) && l.fn == fn && l.ctx == ctx && l.withCtx == withCtx)
                return true;  // already registered: no duplicate
            link = &listeners_[*link].next;
        }
        for (std::size_t s = 0; s < MaxListeners; ++s) {
            if (!listeners_[s].fn) {
                std::uint8_t flags = 0;
                if (dispatchDepth_ > 0) {
                    flags = kPending;
                    dirty_ = true;
                }
                listeners_[s] = Listener{fn, ctx, kNone, withCtx, flags};
                *link = static_cast<std::uint16_t>(s);  // append at the end to preserve registration order
                return true;
            }
        }
        return error(Error::ListenerFull, "state.onChange: MaxListeners reached");
    }

    bool removeListener(Key key, RawFn fn, void* ctx, bool withCtx) {
        const std::size_t i = indexOf(key);
        if (i >= KeyCount) return error(Error::KeyNotFound, "state.removeCallback: variable not registered");
        std::uint16_t* link = &entries_[i].head;
        while (*link != kNone) {
            Listener& l = listeners_[*link];
            if (!(l.flags & kDead) && l.fn == fn && l.ctx == ctx && l.withCtx == withCtx) {
                if (dispatchDepth_ > 0) {  // do not mutate list links while callbacks are running
                    l.flags |= kDead;
                    dirty_ = true;
                } else {
                    *link = l.next;
                    l = Listener{};
                }
                return true;
            }
            link = &l.next;
        }
        return false;
    }

    // Mark all listeners of one key dead. During dispatch, nodes stay linked until
    // collect() can safely release them.
    void detachListeners(std::size_t i) {
        std::uint16_t li = entries_[i].head;
        while (li != kNone) {
            const std::uint16_t next = listeners_[li].next;
            if (dispatchDepth_ > 0) {
                listeners_[li].flags |= kDead;
                dirty_ = true;
            } else {
                listeners_[li] = Listener{};
            }
            li = next;
        }
        entries_[i].head = kNone;
    }

    // ---- Data ------------------------------------------------------------------
    alignas(std::max_align_t) unsigned char pool_[StorageBytes] = {};
    Entry entries_[KeyCount] = {};
    Listener listeners_[kListenerSlots] = {};
    std::size_t used_ = 0;
    std::uint16_t entryCount_ = 0;
    std::uint8_t dispatchDepth_ = 0;  // > 0 while callbacks are running, including nested dispatch
    bool dirty_ = false;              // marked listeners are waiting for collect()
    mutable Error lastErrorCode_ = Error::None;
    mutable const char* lastError_ = nullptr;
    mutable LockPolicy lock_;
    mutable std::uint8_t guardDepth_ = 0;           // see acquire()/release()
    mutable const char* pendingReport_ = nullptr;   // error still waiting to be reported
};
